## config/boards/shields/ergonaut_one_s/Kconfig.defconfig
```kconfig
# Copyright (c) 2020 The ZMK Contributors
# SPDX-License-Identifier: MIT

if SHIELD_ERGONAUT_ONE_S_LEFT

config ZMK_KEYBOARD_NAME
	default "Ergonaut One S"

config ZMK_SPLIT_ROLE_CENTRAL
	default y

config USB_HID_POLL_INTERVAL_MS
	default 1

config ZMK_USB_BOOT
	default y

endif

if SHIELD_ERGONAUT_ONE_S_LEFT || SHIELD_ERGONAUT_ONE_S_RIGHT

config ZMK_SPLIT
	default y

endif
```
